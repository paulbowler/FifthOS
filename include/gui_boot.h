#pragma once

#include <Arduino.h>

struct GuiBootPhase {
    const char* name;
    const char* script;
};

const char fifthos_gui_boot_phase1[] =
R"FIFTH(
\ FifthOS foundation vocabulary

HEX
0000 CONSTANT BLACK
FFFF CONSTANT WHITE
F800 CONSTANT RED
07E0 CONSTANT GREEN
001F CONSTANT BLUE
7DFF CONSTANT ICE
3A8F CONSTANT ICE-DIM
1290 CONSTANT ICE-LOW
FD20 CONSTANT ORANGE
7BEF CONSTANT GRAY
39E7 CONSTANT DARK-GRAY
1082 CONSTANT INK-1
2104 CONSTANT INK-2
4208 CONSTANT INK-3
DECIMAL

: 0= 0 = ;

VARIABLE CAL.DRAW.DAY#
VARIABLE CAL.DRAW.LEN
VARIABLE CAL.DRAW.ADDR
VARIABLE CAL.DRAW.COL
VARIABLE CAL.DRAW.ROW
VARIABLE CAL.DRAW.X
VARIABLE CAL.DRAW.Y

: DROP5 DROP DROP DROP DROP DROP ;

: CENTER-TEXT { x y w addr len color -- }
  addr len TEXT-W w SWAP - 2/ x +
  y addr len color TEXT ;

: RIGHT-TEXT { x y w addr len color -- }
  addr len TEXT-W w SWAP - x +
  y addr len color TEXT ;

: BORDER RECT ;

: PANEL { x y w h fill border -- }
  x y w h fill FILL-RECT
  x y w h border RECT ;

: LABEL TEXT ;

: STATUS-BAR { x y w h addr len color bg -- }
  x y w h bg FILL-RECT
  x y w addr len color CENTER-TEXT ;

: PROGRESS-BAR { x y w h value max fg bg -- }
  x y w h bg FILL-RECT
  x y value w max */ h fg FILL-RECT ;

: HLINE { x y w color -- }
  x y x w + y color LINE ;

: VLINE { x y h color -- }
  x y x y h + color LINE ;

: CLEAR-REGION FILL-RECT ;
: INSET-RECT >R R@ + SWAP R@ + SWAP R@ 2* - SWAP R> 2* - ;

0 CONSTANT STYLE>FG
1 CONSTANT STYLE>BG
2 CONSTANT STYLE>BORDER
3 CONSTANT STYLE>PADDING
4 CONSTANT STYLE>FONT

0 CONSTANT NODE>PARENT
1 CONSTANT NODE>FIRST
2 CONSTANT NODE>NEXT
3 CONSTANT NODE>X
4 CONSTANT NODE>Y
5 CONSTANT NODE>W
6 CONSTANT NODE>H
7 CONSTANT NODE>FLAGS
8 CONSTANT NODE>DRAW
9 CONSTANT NODE>EVENT
10 CONSTANT NODE>STYLE
11 CONSTANT NODE>USER
12 CONSTANT NODE>KIND
13 CONSTANT NODE>TEXT
14 CONSTANT NODE>TEXTLEN
15 CONSTANT NODE>BIND
16 CONSTANT NODE>MIN
17 CONSTANT NODE>MAX
18 CONSTANT NODE>POINTS
19 CONSTANT NODE>COUNT

1 CONSTANT NODE.VISIBLE
2 CONSTANT NODE.DIRTY.FLAG
4 CONSTANT NODE.TOUCHABLE
8 CONSTANT NODE.FOCUSABLE

: STYLE.MAKE STYLE.NEW DUP >R STYLE.SET R> ;

: STYLE.FG STYLE>FG STYLE.FIELD@ ;
: STYLE.BG STYLE>BG STYLE.FIELD@ ;
: STYLE.BORDER STYLE>BORDER STYLE.FIELD@ ;

: NODE.DRAW! NODE>DRAW NODE.FIELD! ;
: NODE.EVENT! NODE>EVENT NODE.FIELD! ;
: NODE.STYLE! NODE>STYLE NODE.FIELD! ;
: NODE.COLOR NODE>STYLE NODE.FIELD@ STYLE.FG ;

: SCREEN.NEW { style -- node }
  NODE.NEW DUP >R
  0 0 SCREEN.W SCREEN.H R@ NODE.SET-BOUNDS
  NODE.VISIBLE NODE.DIRTY.FLAG OR NODE.TOUCHABLE OR R@ NODE>FLAGS NODE.FIELD!
  style R@ NODE>STYLE NODE.FIELD!
  R> ;

: DRAW.NODE { parent x y w h style drawxt -- node }
  NODE.NEW DUP >R
  parent R@ NODE.ADD
  drawxt R@ NODE.DRAW!
  style R@ NODE.STYLE!
  x y w h R@ NODE.SET-BOUNDS
  R> ;

: GUI.PANEL W.PANEL ;
: GUI.LABEL W.LABEL ;
: GUI.BUTTON W.BUTTON ;
: GUI.STATUS W.STATUS ;
: GUI.VALUE W.VALUE ;
: GUI.GAUGE W.GAUGE ;
: GUI.CHART W.CHART ;
: GUI.ALARM W.ALARM ;
: GUI.ICON16 W.ICON16 ;
: ICON.1BIT BITMAP1 ;

: TOUCH.DEBUG
  TOUCH.UPDATE DROP
  ." touch type=" TOUCH.TYPE .
  ." x=" TOUCH.X .
  ." y=" TOUCH.Y .
  ." dx=" TOUCH.DX .
  ." dy=" TOUCH.DY . CR ;

: PUT2
  >R
  10 /MOD DIGIT R@ C!
  DIGIT R> 1+ C! ;

: WDAY>BUF { w addr -- }
  w 0 = IF 83 addr 0 + C! 85 addr 1 + C! 78 addr 2 + C! THEN
  w 1 = IF 77 addr 0 + C! 79 addr 1 + C! 78 addr 2 + C! THEN
  w 2 = IF 84 addr 0 + C! 85 addr 1 + C! 69 addr 2 + C! THEN
  w 3 = IF 87 addr 0 + C! 69 addr 1 + C! 68 addr 2 + C! THEN
  w 4 = IF 84 addr 0 + C! 72 addr 1 + C! 85 addr 2 + C! THEN
  w 5 = IF 70 addr 0 + C! 82 addr 1 + C! 73 addr 2 + C! THEN
  w 6 = IF 83 addr 0 + C! 65 addr 1 + C! 84 addr 2 + C! THEN ;
)FIFTH";

const char fifthos_gui_boot_phase2[] =
R"FIFTH(
\ FifthOS generic UI kit

12 CONSTANT GAP
12 CONSTANT EDGE
40 CONSTANT CONTENT.Y

: FACE.X EDGE ;
: FACE.W SCREEN.W EDGE 2* - ;
: FACE.H SCREEN.H ;
: CONTENT.H SCREEN.H CONTENT.Y - ;
: HALF.W FACE.W GAP - 2/ ;
: RIGHT.X HALF.W GAP + ;

VARIABLE STYLE.ROOT
VARIABLE STYLE.RAIL
VARIABLE STYLE.NAV.IDLE
VARIABLE STYLE.NAV.ACTIVE
VARIABLE STYLE.TITLE
VARIABLE STYLE.SUB
VARIABLE STYLE.CARD
VARIABLE STYLE.HERO
VARIABLE STYLE.MUTED
VARIABLE STYLE.ACCENT
VARIABLE STYLE.ALERT
VARIABLE STYLE.BUTTON
VARIABLE STYLE.METRIC
VARIABLE STYLE.NAV.TEXT
VARIABLE STYLE.BIG
VARIABLE STYLE.RIBBON
VARIABLE STYLE.CLOCK.TIME
VARIABLE STYLE.CLOCK.SEC
VARIABLE STYLE.CLOCK.INFO

: FACE.PANEL { parent x y w h style -- node }
  parent FACE.X x + y w h style GUI.PANEL ;

: FACE.LABEL { parent x y w h style addr len -- node }
  parent FACE.X x + y w h style addr len GUI.LABEL ;

: FACE.BUTTON { parent x y w h style addr len xt -- node }
  parent FACE.X x + y w h style addr len xt GUI.BUTTON ;

: FACE.VALUE { parent x y w h style bind min max -- node }
  parent FACE.X x + y w h style bind min max GUI.VALUE ;

: FACE.STATUS { parent x y w h style addr len -- node }
  parent FACE.X x + y w h style addr len GUI.STATUS ;

: FACE.GAUGE { parent x y w h style bind min max -- node }
  parent FACE.X x + y w h style bind min max GUI.GAUGE ;

: FACE.CHART { parent x y w h style points count min max -- node }
  parent FACE.X x + y w h style points count min max GUI.CHART ;

: FACE.ALARM { parent x y w h style addr len bind -- node }
  parent FACE.X x + y w h style addr len bind GUI.ALARM ;

: FACE.ICON { parent x y style bitmap scale -- node }
  parent FACE.X x + y style bitmap scale GUI.ICON16 ;

: SCREEN.TITLE
  DROP DROP DROP ;

: SCREEN.SUBTITLE
  DROP DROP DROP ;

: NAV.STYLE = IF STYLE.NAV.ACTIVE @ ELSE STYLE.NAV.IDLE @ THEN ;

: BUILD.SHELL
  DROP DROP DROP DROP DROP DROP ;

: FACE.RULE { parent y -- }
  parent 0 y FACE.W 1 STYLE.ACCENT @ FACE.PANEL DROP ;

: FACE.BOX { x y w h border -- }
  x y w h BLACK border PANEL ;

: FACE.INVERT { parent x y w h addr len bg -- }
  parent FACE.X x + y w h bg GUI.PANEL DROP
  parent FACE.X x + y w h addr len BLACK GUI.LABEL DROP ;

CREATE ICON.RAIN.DATA
HEX
03C0 , 07E0 , 0E70 , 1C38 ,
1C38 , 3FFC , 7FFE , 7FFE ,
3FFC , 0630 , 0C18 , 0630 ,
0C18 , 0000 , 0000 , 0000 ,
DECIMAL

: ICON.RAIN { x y scale color -- }
  x y 16 16 scale color ICON.RAIN.DATA ICON.1BIT ;

CREATE ICON.CLOCK.DATA
HEX
03C0 , 0FF0 , 1C38 , 300C ,
67E6 , 6C36 , 6C36 , 6FF6 ,
6C36 , 6C36 , 300C , 1C38 ,
0FF0 , 03C0 , 0000 , 0000 ,
DECIMAL

: ICON.CLOCK { x y scale color -- }
  x y 16 16 scale color ICON.CLOCK.DATA ICON.1BIT ;

CREATE ICON.CALENDAR.DATA
HEX
7FFE , 6006 , 6C36 , 6C36 ,
7FFE , 6006 , 6F66 , 6F66 ,
6F66 , 6F66 , 6F66 , 6F66 ,
6006 , 7FFE , 0000 , 0000 ,
DECIMAL

: ICON.CALENDAR { x y scale color -- }
  x y 16 16 scale color ICON.CALENDAR.DATA ICON.1BIT ;

CREATE ICON.ALARM.DATA
HEX
0180 , 03C0 , 0C30 , 1818 ,
300C , 300C , 300C , 3FFC ,
3FFC , 0FF0 , 03C0 , 03C0 ,
0180 , 0300 , 0000 , 0000 ,
DECIMAL

: ICON.ALARM { x y scale color -- }
  x y 16 16 scale color ICON.ALARM.DATA ICON.1BIT ;

: ADD.NAV.ITEM { parent x style bitmap -- }
  parent x 6 style bitmap 2 FACE.ICON DROP ;

: ADD.NAV.CLOCK { parent -- }
  parent 96 STYLE.NAV.ACTIVE @ ICON.CLOCK.DATA ADD.NAV.ITEM
  parent 166 STYLE.NAV.IDLE @ ICON.CALENDAR.DATA ADD.NAV.ITEM
  parent 236 STYLE.NAV.IDLE @ ICON.ALARM.DATA ADD.NAV.ITEM
  parent 306 STYLE.NAV.IDLE @ ICON.RAIN.DATA ADD.NAV.ITEM ;

: ADD.NAV.CALENDAR { parent -- }
  parent 96 STYLE.NAV.IDLE @ ICON.CLOCK.DATA ADD.NAV.ITEM
  parent 166 STYLE.NAV.ACTIVE @ ICON.CALENDAR.DATA ADD.NAV.ITEM
  parent 236 STYLE.NAV.IDLE @ ICON.ALARM.DATA ADD.NAV.ITEM
  parent 306 STYLE.NAV.IDLE @ ICON.RAIN.DATA ADD.NAV.ITEM ;

: ADD.NAV.ALARMS { parent -- }
  parent 96 STYLE.NAV.IDLE @ ICON.CLOCK.DATA ADD.NAV.ITEM
  parent 166 STYLE.NAV.IDLE @ ICON.CALENDAR.DATA ADD.NAV.ITEM
  parent 236 STYLE.NAV.ACTIVE @ ICON.ALARM.DATA ADD.NAV.ITEM
  parent 306 STYLE.NAV.IDLE @ ICON.RAIN.DATA ADD.NAV.ITEM ;

: ADD.NAV.WEATHER { parent -- }
  parent 96 STYLE.NAV.IDLE @ ICON.CLOCK.DATA ADD.NAV.ITEM
  parent 166 STYLE.NAV.IDLE @ ICON.CALENDAR.DATA ADD.NAV.ITEM
  parent 236 STYLE.NAV.IDLE @ ICON.ALARM.DATA ADD.NAV.ITEM
  parent 306 STYLE.NAV.ACTIVE @ ICON.RAIN.DATA ADD.NAV.ITEM ;

: ADD.WEATHER.BADGE { parent -- }
  parent 294 58 STYLE.TITLE @ ICON.RAIN.DATA 2 FACE.ICON DROP ;
)FIFTH";

const char fifthos_gui_boot_phase3[] =
R"FIFTH(
\ FifthOS app state and callbacks

VARIABLE FIFTH.APP
VARIABLE SCREEN.CLOCK
VARIABLE SCREEN.CALENDAR
VARIABLE SCREEN.ALARMS
VARIABLE SCREEN.WEATHER
VARIABLE TASK.CLOCK
VARIABLE NODE.CLOCK.HH
VARIABLE NODE.CLOCK.MM
VARIABLE NODE.CLOCK.SS
VARIABLE NODE.CLOCK.INFO
VARIABLE NODE.CALENDAR.TITLE
VARIABLE CLOCK.HOUR
VARIABLE CLOCK.MINUTE
VARIABLE CLOCK.SECOND
VARIABLE CLOCK.DAY
VARIABLE CLOCK.MONTH
VARIABLE CLOCK.YEAR
VARIABLE CLOCK.WDAY
VARIABLE CAL.YEAR
VARIABLE CAL.MONTH
VARIABLE CAL.DAY
VARIABLE CAL.FIRST
VARIABLE CAL.DAYS
VARIABLE CAL.CURSOR

VARIABLE CLOCK.FOCUS
VARIABLE ALARM.ARMED
VARIABLE WEATHER.TEMP
VARIABLE WEATHER.WIND
VARIABLE WEATHER.HUM

HERE 8 ALLOT CONSTANT CLOCK.TIME.BUF
HERE 2 ALLOT CONSTANT CLOCK.HH.BUF
HERE 2 ALLOT CONSTANT CLOCK.MM.BUF
HERE 2 ALLOT CONSTANT CLOCK.SS.BUF
HERE 1 ALLOT CONSTANT CLOCK.COLON.BUF
HERE 10 ALLOT CONSTANT CLOCK.DATE.BUF
HERE 3 ALLOT CONSTANT CLOCK.WDAY.BUF
HERE 14 ALLOT CONSTANT CLOCK.INFO.BUF
HERE 15 ALLOT CONSTANT CAL.TITLE.BUF
HERE 2 ALLOT CONSTANT CAL.DAY.BUF

73 CLOCK.FOCUS !
1 ALARM.ARMED !
18 WEATHER.TEMP !
14 WEATHER.WIND !
67 WEATHER.HUM !
0 TASK.CLOCK !
58 CLOCK.COLON.BUF C!

CREATE WEATHER.TREND 8 CELLS ALLOT
16 WEATHER.TREND !
17 WEATHER.TREND CELL+ !
18 WEATHER.TREND CELL+ CELL+ !
20 WEATHER.TREND 3 CELLS + !
22 WEATHER.TREND 4 CELLS + !
21 WEATHER.TREND 5 CELLS + !
19 WEATHER.TREND 6 CELLS + !
18 WEATHER.TREND 7 CELLS + !

: NAV.TAP? { event target tick x y -- flag }
  target DROP
  tick DROP
  x DROP
  y DROP
  event TOUCH.TAP = ;

: SHOW.CLOCK { event target tick x y -- }
  event target tick x y NAV.TAP? IF FIFTH.APP @ 0 APP.SHOW THEN ;
' SHOW.CLOCK CONSTANT SHOW.CLOCK.XT

: SHOW.CALENDAR { event target tick x y -- }
  event target tick x y NAV.TAP? IF FIFTH.APP @ 1 APP.SHOW THEN ;
' SHOW.CALENDAR CONSTANT SHOW.CALENDAR.XT

: SHOW.ALARMS { event target tick x y -- }
  event target tick x y NAV.TAP? IF FIFTH.APP @ 2 APP.SHOW THEN ;
' SHOW.ALARMS CONSTANT SHOW.ALARMS.XT

: SHOW.WEATHER { event target tick x y -- }
  event target tick x y NAV.TAP? IF FIFTH.APP @ 3 APP.SHOW THEN ;
' SHOW.WEATHER CONSTANT SHOW.WEATHER.XT

: HANDLE.NAV.TAP { event target tick x y -- }
  event target tick x y NAV.TAP? IF
    y 40 < IF
      x 96  < 0= x 128 < AND IF FIFTH.APP @ 0 APP.SHOW THEN
      x 166 < 0= x 198 < AND IF FIFTH.APP @ 1 APP.SHOW THEN
      x 236 < 0= x 268 < AND IF FIFTH.APP @ 2 APP.SHOW THEN
      x 306 < 0= x 338 < AND IF FIFTH.APP @ 3 APP.SHOW THEN
    THEN
  THEN ;
' HANDLE.NAV.TAP CONSTANT HANDLE.NAV.TAP.XT

: TOGGLE.ALARM { event target tick x y -- }
  event target tick x y NAV.TAP? IF
    ALARM.ARMED @ 0= IF 1 ELSE 0 THEN ALARM.ARMED !
    SCREEN.ALARMS @ NODE.DIRTY
  THEN ;
' TOGGLE.ALARM CONSTANT TOGGLE.ALARM.XT

: CLOCK.SET-HMS { hh mm ss -- }
  hh CLOCK.HH.BUF PUT2
  mm CLOCK.MM.BUF PUT2
  ss CLOCK.SS.BUF PUT2
  hh CLOCK.TIME.BUF PUT2
  58 CLOCK.TIME.BUF 2 + C!
  mm CLOCK.TIME.BUF 3 + PUT2
  58 CLOCK.TIME.BUF 5 + C!
  ss CLOCK.TIME.BUF 6 + PUT2 ;

: CLOCK.BUFFERS.UPDATE
  TIME.HMS CLOCK.SET-HMS ;

: CLOCK.SET-DATE { yyyy mm dd wday -- }
  dd CLOCK.DATE.BUF PUT2
  47 CLOCK.DATE.BUF 2 + C!
  mm CLOCK.DATE.BUF 3 + PUT2
  47 CLOCK.DATE.BUF 5 + C!
  yyyy 1000 / DIGIT CLOCK.DATE.BUF 6 + C!
  yyyy 1000 MOD 100 / DIGIT CLOCK.DATE.BUF 7 + C!
  yyyy 100 MOD 10 / DIGIT CLOCK.DATE.BUF 8 + C!
  yyyy 10 MOD DIGIT CLOCK.DATE.BUF 9 + C!
  wday CLOCK.INFO.BUF WDAY>BUF
  32 CLOCK.INFO.BUF 3 + C!
  CLOCK.DATE.BUF C@ CLOCK.INFO.BUF 4 + C!
  CLOCK.DATE.BUF 1+ C@ CLOCK.INFO.BUF 5 + C!
  CLOCK.DATE.BUF 2 + C@ CLOCK.INFO.BUF 6 + C!
  CLOCK.DATE.BUF 3 + C@ CLOCK.INFO.BUF 7 + C!
  CLOCK.DATE.BUF 4 + C@ CLOCK.INFO.BUF 8 + C!
  CLOCK.DATE.BUF 5 + C@ CLOCK.INFO.BUF 9 + C!
  CLOCK.DATE.BUF 6 + C@ CLOCK.INFO.BUF 10 + C!
  CLOCK.DATE.BUF 7 + C@ CLOCK.INFO.BUF 11 + C!
  CLOCK.DATE.BUF 8 + C@ CLOCK.INFO.BUF 12 + C!
  CLOCK.DATE.BUF 9 + C@ CLOCK.INFO.BUF 13 + C! ;

: CLOCK.DATE.UPDATE
  TIME.YMD TIME.WDAY CLOCK.SET-DATE ;

: DAY.TEXT
  DUP 10 < IF
    DIGIT CAL.DAY.BUF C!
    DROP CAL.DAY.BUF 1 EXIT
  THEN
  10 /MOD
  DIGIT CAL.DAY.BUF C!
  DIGIT CAL.DAY.BUF 1+ C!
  CAL.DAY.BUF 2 ;

: MONTH>BUF { month addr -- }
  month 1  = IF 74 addr 0 + C! 65 addr 1 + C! 78 addr 2 + C! THEN
  month 2  = IF 70 addr 0 + C! 69 addr 1 + C! 66 addr 2 + C! THEN
  month 3  = IF 77 addr 0 + C! 65 addr 1 + C! 82 addr 2 + C! THEN
  month 4  = IF 65 addr 0 + C! 80 addr 1 + C! 82 addr 2 + C! THEN
  month 5  = IF 77 addr 0 + C! 65 addr 1 + C! 89 addr 2 + C! THEN
  month 6  = IF 74 addr 0 + C! 85 addr 1 + C! 78 addr 2 + C! THEN
  month 7  = IF 74 addr 0 + C! 85 addr 1 + C! 76 addr 2 + C! THEN
  month 8  = IF 65 addr 0 + C! 85 addr 1 + C! 71 addr 2 + C! THEN
  month 9  = IF 83 addr 0 + C! 69 addr 1 + C! 80 addr 2 + C! THEN
  month 10 = IF 79 addr 0 + C! 67 addr 1 + C! 84 addr 2 + C! THEN
  month 11 = IF 78 addr 0 + C! 79 addr 1 + C! 86 addr 2 + C! THEN
  month 12 = IF 68 addr 0 + C! 69 addr 1 + C! 67 addr 2 + C! THEN ;

: CALENDAR.SET-TITLE { yyyy mm dd -- }
  CLOCK.INFO.BUF C@ CAL.TITLE.BUF 0 + C!
  CLOCK.INFO.BUF 1+ C@ CAL.TITLE.BUF 1 + C!
  CLOCK.INFO.BUF 2 + C@ CAL.TITLE.BUF 2 + C!
  32 CAL.TITLE.BUF 3 + C!
  dd DAY.TEXT 2DROP
  CAL.DAY.BUF C@ CAL.TITLE.BUF 4 + C!
  CAL.DAY.BUF 1+ C@ CAL.TITLE.BUF 5 + C!
  32 CAL.TITLE.BUF 6 + C!
  mm CAL.TITLE.BUF 7 + MONTH>BUF
  32 CAL.TITLE.BUF 10 + C!
  yyyy 1000 / DIGIT CAL.TITLE.BUF 11 + C!
  yyyy 1000 MOD 100 / DIGIT CAL.TITLE.BUF 12 + C!
  yyyy 100 MOD 10 / DIGIT CAL.TITLE.BUF 13 + C!
  yyyy 10 MOD DIGIT CAL.TITLE.BUF 14 + C! ;

: CALENDAR.SET-YMD { yyyy mm dd -- }
  yyyy CAL.YEAR !
  mm CAL.MONTH !
  dd CAL.DAY !
  yyyy mm TIME.MONTH.FIRST CAL.FIRST !
  yyyy mm TIME.MONTH.DAYS CAL.DAYS !
  yyyy mm dd CALENDAR.SET-TITLE ;

: CALENDAR.BUFFERS.UPDATE
  TIME.YMD CALENDAR.SET-YMD ;

: CLOCK.REFRESH.HMS { hh mm ss -- }
  hh CLOCK.HOUR @ = 0= IF
    hh CLOCK.HOUR !
    hh CLOCK.HH.BUF PUT2
    NODE.CLOCK.HH @ NODE.DIRTY
  THEN
  mm CLOCK.MINUTE @ = 0= IF
    mm CLOCK.MINUTE !
    mm CLOCK.MM.BUF PUT2
    NODE.CLOCK.MM @ NODE.DIRTY
  THEN
  ss CLOCK.SECOND @ = 0= IF
    ss CLOCK.SECOND !
    ss CLOCK.SS.BUF PUT2
    NODE.CLOCK.SS @ NODE.DIRTY
  THEN
  hh CLOCK.TIME.BUF PUT2
  58 CLOCK.TIME.BUF 2 + C!
  mm CLOCK.TIME.BUF 3 + PUT2
  58 CLOCK.TIME.BUF 5 + C!
  ss CLOCK.TIME.BUF 6 + PUT2 ;

: CLOCK.REFRESH.DATE { yyyy mm2 dd wday -- }
  dd CLOCK.DAY @ = 0=
  mm2 CLOCK.MONTH @ = 0= OR
  yyyy CLOCK.YEAR @ = 0= OR
  wday CLOCK.WDAY @ = 0= OR
  IF
    dd CLOCK.DAY !
    mm2 CLOCK.MONTH !
    yyyy CLOCK.YEAR !
    wday CLOCK.WDAY !
    CLOCK.DATE.UPDATE
    CALENDAR.BUFFERS.UPDATE
    NODE.CLOCK.INFO @ NODE.DIRTY
    NODE.CALENDAR.TITLE @ NODE.DIRTY
    SCREEN.CALENDAR @ NODE.DIRTY
  THEN ;

: CLOCK.REFRESH
  TIME.HMS CLOCK.REFRESH.HMS
  TIME.YMD TIME.WDAY CLOCK.REFRESH.DATE ;
' CLOCK.REFRESH CONSTANT CLOCK.REFRESH.XT

: CLOCK.TASK.CONFIG { task -- }
  task 1000 CLOCK.REFRESH.XT TASK.EVERY
  task TASK.START ;

: START.DATA.TASKS
  TASK.CLOCK @ ?DUP IF
    DUP TASK.STOP
    CLOCK.TASK.CONFIG
    EXIT
  THEN
  TASK.NEW DUP TASK.CLOCK !
  CLOCK.TASK.CONFIG ;

: DEMO.TICK { event target tick x y -- }
  target DROP
  tick DROP
  x DROP
  y DROP
  event TIMER = IF
    CLOCK.FOCUS @ 3 + 100 MOD CLOCK.FOCUS !
    WEATHER.TEMP @ 1+ DUP 25 SWAP < IF DROP 17 THEN WEATHER.TEMP !
    WEATHER.WIND @ 1+ DUP 20 SWAP < IF DROP 11 THEN WEATHER.WIND !
    WEATHER.HUM @ 2 + DUP 86 SWAP < IF DROP 58 THEN WEATHER.HUM !
    SCREEN.WEATHER @ NODE.DIRTY
  THEN ;
' DEMO.TICK CONSTANT DEMO.TICK.XT

: ROOT.DRAW.CLOCK DROP ;
' ROOT.DRAW.CLOCK CONSTANT ROOT.DRAW.CLOCK.XT

: CAL.COL.W FACE.W 7 / ;
: CAL.HEADER { col addr len -- }
  2 TEXT-SCALE
  col CAL.COL.W * FACE.X + 96 CAL.COL.W addr len ICE CENTER-TEXT ;

: CAL.DRAW.DAY
  CAL.DRAW.DAY# !
  CAL.FIRST @ CAL.DRAW.DAY# @ 1- + 7 /MOD CAL.DRAW.ROW ! CAL.DRAW.COL !
  CAL.DRAW.COL @ CAL.COL.W * FACE.X + CAL.DRAW.X !
  CAL.DRAW.ROW @ 24 * 118 + CAL.DRAW.Y !
  CAL.DRAW.DAY# @ DAY.TEXT CAL.DRAW.LEN ! CAL.DRAW.ADDR !
  CAL.DRAW.DAY# @ CAL.DAY @ = IF
    CAL.DRAW.X @ CAL.DRAW.Y @ CAL.COL.W 20 WHITE FILL-RECT
    CAL.DRAW.X @ CAL.DRAW.Y @ 2 + CAL.COL.W CAL.DRAW.ADDR @ CAL.DRAW.LEN @ BLACK CENTER-TEXT
  ELSE
    CAL.DRAW.X @ CAL.DRAW.Y @ 2 + CAL.COL.W CAL.DRAW.ADDR @ CAL.DRAW.LEN @ GRAY CENTER-TEXT
  THEN ;

: ROOT.DRAW.CALENDAR
  DROP
  FACE.X 88 FACE.W SCREEN.H 88 - BLACK FILL-RECT
  2 TEXT-SCALE
  0 $" MON" COUNT CAL.HEADER
  1 $" TUE" COUNT CAL.HEADER
  2 $" WED" COUNT CAL.HEADER
  3 $" THU" COUNT CAL.HEADER
  4 $" FRI" COUNT CAL.HEADER
  5 $" SAT" COUNT CAL.HEADER
  6 $" SUN" COUNT CAL.HEADER
  2 TEXT-SCALE
  1 CAL.CURSOR !
  BEGIN
    CAL.DAYS @ CAL.CURSOR @ < 0=
  WHILE
    CAL.CURSOR @ CAL.DRAW.DAY
    CAL.CURSOR @ 1+ CAL.CURSOR !
  REPEAT
  1 TEXT-SCALE ;
' ROOT.DRAW.CALENDAR CONSTANT ROOT.DRAW.CALENDAR.XT

: ROOT.DRAW.ALARMS DROP ;
' ROOT.DRAW.ALARMS CONSTANT ROOT.DRAW.ALARMS.XT

: ROOT.DRAW.WEATHER DROP ;
' ROOT.DRAW.WEATHER CONSTANT ROOT.DRAW.WEATHER.XT

: CLOCK.ROOT.EVENT
  HANDLE.NAV.TAP ;
' CLOCK.ROOT.EVENT CONSTANT CLOCK.ROOT.EVENT.XT

: SIMPLE.ROOT.EVENT
  HANDLE.NAV.TAP ;
' SIMPLE.ROOT.EVENT CONSTANT SIMPLE.ROOT.EVENT.XT

: WEATHER.ROOT.EVENT
  HANDLE.NAV.TAP
  DEMO.TICK ;
' WEATHER.ROOT.EVENT CONSTANT WEATHER.ROOT.EVENT.XT

: BUILD.STYLES
  ICE BLACK BLACK 0 1 STYLE.MAKE STYLE.ROOT !
  ICE BLACK BLACK 0 1 STYLE.MAKE STYLE.RAIL !
  GRAY BLACK BLACK 0 1 STYLE.MAKE STYLE.NAV.IDLE !
  WHITE BLACK BLACK 0 1 STYLE.MAKE STYLE.NAV.ACTIVE !
  ICE BLACK BLACK 0 2 STYLE.MAKE STYLE.TITLE !
  ICE-DIM BLACK BLACK 0 1 STYLE.MAKE STYLE.SUB !
  ICE-DIM BLACK ICE-DIM 2 1 STYLE.MAKE STYLE.CARD !
  ICE BLACK BLACK 0 5 STYLE.MAKE STYLE.HERO !
  ICE BLACK BLACK 0 8 STYLE.MAKE STYLE.CLOCK.TIME !
  ICE BLACK BLACK 0 6 STYLE.MAKE STYLE.CLOCK.SEC !
  ICE BLACK BLACK 0 3 STYLE.MAKE STYLE.CLOCK.INFO !
  ICE-LOW BLACK BLACK 0 1 STYLE.MAKE STYLE.MUTED !
  ICE BLACK ICE 2 1 STYLE.MAKE STYLE.ACCENT !
  ORANGE BLACK ORANGE 2 1 STYLE.MAKE STYLE.ALERT !
  BLACK ICE ICE 2 1 STYLE.MAKE STYLE.BUTTON !
  ICE BLACK ICE-DIM 2 2 STYLE.MAKE STYLE.METRIC !
  ICE BLACK BLACK 0 1 STYLE.MAKE STYLE.NAV.TEXT !
  ICE BLACK BLACK 0 3 STYLE.MAKE STYLE.BIG !
  BLACK ICE-DIM ICE-DIM 1 1 STYLE.MAKE STYLE.RIBBON ! ;
)FIFTH";

const char fifthos_gui_boot_phase4[] =
R"FIFTH(
\ FifthOS app screens

: ADD.NAV
  DROP DROP ;

: BUILD.CLOCK.SCREEN { screen -- }
  ROOT.DRAW.CLOCK.XT screen NODE.DRAW!
  CLOCK.ROOT.EVENT.XT screen NODE.EVENT!
  screen 0 $" CLOCK" COUNT $" LIVE FACE" COUNT BUILD.SHELL
  screen ADD.NAV.CLOCK
  screen 46 FACE.RULE
  screen 32 88 120 92 STYLE.CLOCK.TIME @ CLOCK.HH.BUF 2 FACE.STATUS NODE.CLOCK.HH !
  screen 146 88 24 92 STYLE.CLOCK.TIME @ CLOCK.COLON.BUF 1 FACE.STATUS DROP
  screen 184 88 120 92 STYLE.CLOCK.TIME @ CLOCK.MM.BUF 2 FACE.STATUS NODE.CLOCK.MM !
  screen 298 88 24 92 STYLE.CLOCK.TIME @ CLOCK.COLON.BUF 1 FACE.STATUS DROP
  screen 336 88 120 92 STYLE.CLOCK.TIME @ CLOCK.SS.BUF 2 FACE.STATUS NODE.CLOCK.SS !
  screen 0 196 FACE.W 1 STYLE.ACCENT @ FACE.PANEL DROP
  screen 0 212 FACE.W 24 STYLE.CLOCK.INFO @ CLOCK.INFO.BUF 14 FACE.STATUS NODE.CLOCK.INFO ! ;

: BUILD.CLOCK
  STYLE.ROOT @ SCREEN.NEW DUP SCREEN.CLOCK !
  SCREEN.CLOCK @ BUILD.CLOCK.SCREEN ;

: BUILD.CALENDAR.SCREEN { screen -- }
  ROOT.DRAW.CALENDAR.XT screen NODE.DRAW!
  SIMPLE.ROOT.EVENT.XT screen NODE.EVENT!
  screen 1 $" CALENDAR" COUNT $" MONTH VIEW" COUNT BUILD.SHELL
  screen ADD.NAV.CALENDAR
  screen 46 FACE.RULE
  screen 0 58 FACE.W 24 STYLE.BIG @ CAL.TITLE.BUF 15 FACE.STATUS NODE.CALENDAR.TITLE ! ;

: BUILD.CALENDAR
  STYLE.ROOT @ SCREEN.NEW DUP SCREEN.CALENDAR !
  SCREEN.CALENDAR @ BUILD.CALENDAR.SCREEN ;

: BUILD.ALARMS.SCREEN { screen -- }
  ROOT.DRAW.ALARMS.XT screen NODE.DRAW!
  SIMPLE.ROOT.EVENT.XT screen NODE.EVENT!
  screen 2 $" ALARMS" COUNT $" READY SET" COUNT BUILD.SHELL
  screen ADD.NAV.ALARMS
  screen 40 FACE.RULE
  screen 8 54 70 12 STYLE.MUTED @ $" NEXT" COUNT FACE.LABEL DROP
  screen 8 74 190 72 STYLE.HERO @ $" 06:30" COUNT FACE.LABEL DROP
  screen 226 58 72 12 STYLE.MUTED @ $" MODE" COUNT FACE.LABEL DROP
  screen 226 76 96 18 STYLE.TITLE @ $" MON-FRI" COUNT FACE.LABEL DROP
  screen 226 100 110 12 STYLE.SUB @ $" BEDROOM" COUNT FACE.LABEL DROP
  screen 336 60 120 30 STYLE.ALERT @ $" ARMED" COUNT ALARM.ARMED FACE.ALARM DROP
  screen 0 154 FACE.W 1 STYLE.ACCENT @ FACE.PANEL DROP
  screen 0 166 216 24 STYLE.CARD @ FACE.BOX DROP
  screen 12 172 156 12 STYLE.TITLE @ $" 07:15 STUDIO" COUNT FACE.LABEL DROP
  screen 240 166 216 24 STYLE.CARD @ FACE.BOX DROP
  screen 252 172 150 12 STYLE.TITLE @ $" 08:40 TRAINING" COUNT FACE.LABEL DROP
  screen 120 198 216 24 STYLE.BUTTON @ $" TOGGLE ARM" COUNT TOGGLE.ALARM.XT FACE.BUTTON DROP ;

: BUILD.ALARMS
  STYLE.ROOT @ SCREEN.NEW DUP SCREEN.ALARMS !
  SCREEN.ALARMS @ BUILD.ALARMS.SCREEN ;

: BUILD.WEATHER.SCREEN { screen -- }
  ROOT.DRAW.WEATHER.XT screen NODE.DRAW!
  WEATHER.ROOT.EVENT.XT screen NODE.EVENT!
  screen 3 $" WEATHER" COUNT $" LOCAL OUTLOOK" COUNT BUILD.SHELL
  screen ADD.NAV.WEATHER
  screen 40 FACE.RULE
  screen 8 54 96 12 STYLE.MUTED @ $" OUTSIDE" COUNT FACE.LABEL DROP
  screen 8 74 172 72 STYLE.HERO @ $" 18C" COUNT FACE.LABEL DROP
  screen 190 56 STYLE.TITLE @ ICON.RAIN.DATA 3 FACE.ICON DROP
  screen 254 58 170 14 STYLE.TITLE @ $" LIGHT RAIN" COUNT FACE.LABEL DROP
  screen 254 78 160 12 STYLE.SUB @ $" FEELS LIKE 16C" COUNT FACE.LABEL DROP
  screen 254 98 160 12 STYLE.SUB @ $" MAX 30 / MIN 18" COUNT FACE.LABEL DROP
  screen 0 154 FACE.W 1 STYLE.ACCENT @ FACE.PANEL DROP
  screen 0 166 144 56 STYLE.CARD @ FACE.BOX DROP
  screen 12 174 64 10 STYLE.MUTED @ $" HUMID" COUNT FACE.LABEL DROP
  screen 12 190 80 20 STYLE.BIG @ $" 67" COUNT FACE.LABEL DROP
  screen 156 166 144 56 STYLE.CARD @ FACE.BOX DROP
  screen 168 174 58 10 STYLE.MUTED @ $" WIND" COUNT FACE.LABEL DROP
  screen 168 190 86 20 STYLE.BIG @ $" 14K" COUNT FACE.LABEL DROP
  screen 312 166 144 56 STYLE.CARD @ FACE.BOX DROP
  screen 324 174 64 10 STYLE.MUTED @ $" RAIN" COUNT FACE.LABEL DROP
  screen 324 190 80 20 STYLE.BIG @ $" 40%" COUNT FACE.LABEL DROP ;

: BUILD.WEATHER
  STYLE.ROOT @ SCREEN.NEW DUP SCREEN.WEATHER !
  SCREEN.WEATHER @ BUILD.WEATHER.SCREEN ;

: BUILD.APP.SCREENS
  DUP FIFTH.APP !
  DUP SCREEN.CLOCK @ APP.ADD-SCREEN
  DUP SCREEN.CALENDAR @ APP.ADD-SCREEN
  DUP SCREEN.ALARMS @ APP.ADD-SCREEN
  DUP SCREEN.WEATHER @ APP.ADD-SCREEN
  0 APP.SHOW ;

: BUILD.APP
  APP.NEW BUILD.APP.SCREENS ;
)FIFTH";

const char fifthos_gui_boot_phase5[] =
R"FIFTH(
\ FifthOS app bootstrap

: FIFTHOS.GUI
  GFX.INIT
  BUILD.STYLES
  CLOCK.BUFFERS.UPDATE
  CLOCK.DATE.UPDATE
  CALENDAR.BUFFERS.UPDATE
  BUILD.CLOCK
  BUILD.CALENDAR
  BUILD.ALARMS
  BUILD.WEATHER
  BUILD.APP
  START.DATA.TASKS
  FIFTH.APP @ APP.DRAW
  ." FifthOS UI ready" CR ;

FIFTHOS.GUI
)FIFTH";

const GuiBootPhase fifthos_gui_boot_phases[] = {
    { "Phase 1/5: foundation", fifthos_gui_boot_phase1 },
    { "Phase 2/5: ui kit", fifthos_gui_boot_phase2 },
    { "Phase 3/5: app state", fifthos_gui_boot_phase3 },
    { "Phase 4/5: screens", fifthos_gui_boot_phase4 },
    { "Phase 5/5: bootstrap", fifthos_gui_boot_phase5 },
};

constexpr size_t fifthos_gui_boot_phase_count = sizeof(fifthos_gui_boot_phases) / sizeof(fifthos_gui_boot_phases[0]);
